## sdkconfig.defaults
```kconfig
# Rust often needs a bit of an extra main task stack size compared to C (the default is 3K)
CONFIG_ESP_MAIN_TASK_STACK_SIZE=16384
CONFIG_LWIP_LOCAL_HOSTNAME="alumina"
CONFIG_COMPILER_OPTIMIZATION="Release"
CONFIG_ESP_HTTPS_SERVER_ENABLE=y
CONFIG_ESP_TLS_SERVER=y
CONFIG_MBEDTLS_HARDWARE_SHA=y
CONFIG_MBEDTLS_HARDWARE_AES=y
CONFIG_MBEDTLS_HARDWARE_MPI=y
#MBEDTLS_CERTIFICATE_BUNDLE_DEFAULT_CMN=y
CONFIG_SPI_FLASH_SHARE_SPI1_BUS=y
CONFIG_ESP_WIFI_SOFTAP_SUPPORT=y
CONFIG_LWIP_DHCP_SERVER=y

# --- ADD THESE for a custom partition table ---
#CONFIG_PARTITION_TABLE_CUSTOM=y
#CONFIG_PARTITION_TABLE_FILENAME="partitions.csv"
```
